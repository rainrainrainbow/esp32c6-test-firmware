## sdkconfig.defaults
```kconfig
CONFIG_IDF_TARGET="esp32c6"
CONFIG_ESPTOOLPY_FLASHSIZE_4MB=y
CONFIG_ESP_CONSOLE_UART_DEFAULT=y
CONFIG_PARTITION_TABLE_SINGLE_APP=y
# New I2C driver
CONFIG_ESP_I2C_MASTER=y
# Logs
CONFIG_LOG_DEFAULT_LEVEL_INFO=y
```
